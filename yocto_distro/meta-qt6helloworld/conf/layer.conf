## yocto_distro/meta-qt6helloworld/conf/layer.conf
```bitbake
# We have a conf and classes directory, add to BBPATH
BBPATH .= ":${LAYERDIR}"

# We have recipes-* directories, add to BBFILES
BBFILES += "${LAYERDIR}/recipes-*/*/*.bb \
            ${LAYERDIR}/recipes-*/*/*.bbappend"

BBFILE_COLLECTIONS += "meta-qt6helloworld"
BBFILE_PATTERN_meta-qt6helloworld = "^${LAYERDIR}/"
BBFILE_PRIORITY_meta-qt6helloworld = "6"

LAYERDEPENDS_meta-qt6helloworld = "core"
LAYERSERIES_COMPAT_meta-qt6helloworld = "dunfell"
```
